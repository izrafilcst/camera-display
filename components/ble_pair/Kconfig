## components/ble_pair/Kconfig
```kconfig
menu "BLE pairing"

config BLE_SCAN_TIMEOUT_S
    int "BLE scan timeout (seconds)"
    default 30
    range 5 300
    help
        How long ble_pair_run() will scan for a CAM-TX advertisement
        before returning SCAN_TIMEOUT. The TX should be powered on first.

config RECEIVER_FORCE_PAIR_AGAIN
    bool "Wipe pairing NVS at boot and pair again"
    default n
    help
        Useful during development. When set, app_main calls
        pair_nvs_clear() before checking for a saved TX MAC, so the
        device always re-runs the BLE handshake. Disable for normal use.

endmenu
```

## components/espnow_link/Kconfig
```kconfig
menu "ESP-NOW link"
    config RECEIVER_PEER_MAC
        string "Hardcoded peer MAC (V0)"
        default "AA:BB:CC:DD:EE:FF"
        help
            Six-byte MAC of the transmitter, colon-separated (e.g. 84:F7:03:AA:BB:CC).
            MUST be changed before any production build.
            V0 contract: if left at the default placeholder, the firmware will log a
            warning at boot and the link will not work until a real MAC is configured.
            See docs/superpowers/specs/2026-05-26-receptor-design.md §10.
endmenu
```

## main/Kconfig.projbuild
```kconfig
menu "Receiver app"

config RECEIVER_SMOKE_TEST
    bool "Smoke test mode (display-only demo, bypasses ESP-NOW and decode)"
    default n
    help
        When enabled, app_main cycles the Sprint 1 test patterns
        (color bars, gradient, checker, tearing stripes) on the LCD
        and DOES NOT start ESP-NOW, reassembly, decoder, or link_ui
        tasks. Use this to validate display, PSRAM framebuffer,
        LovyanGFX DMA, panel colors and tearing on the physical board
        before a transmitter is available. Disable for the real
        video pipeline.

config RECEIVER_PAIRING_PIN
    int "BLE pairing PIN (uint32 LE written to 0x1235)"
    default 1234
    range 0 4294967295
    help
        Numeric PIN that the RX writes to characteristic 0x1235 during
        the BLE handshake (Phase 1 of the TX protocol). Must match the
        value the TX accepts. 1234 is the documented test PIN.

endmenu
```

## sdkconfig.defaults
```kconfig
CONFIG_IDF_TARGET="esp32s3"
CONFIG_ESP32S3_DEFAULT_CPU_FREQ_240=y
CONFIG_ESPTOOLPY_FLASHSIZE_16MB=y
CONFIG_PARTITION_TABLE_CUSTOM=y
CONFIG_PARTITION_TABLE_CUSTOM_FILENAME="partitions.csv"
CONFIG_SPIRAM=y
CONFIG_SPIRAM_MODE_OCT=y
CONFIG_SPIRAM_SPEED_80M=y
CONFIG_SPIRAM_USE_MALLOC=y
CONFIG_SPIRAM_TRY_ALLOCATE_WIFI_IN_PSRAM=y
CONFIG_COMPILER_OPTIMIZATION_PERF=y
CONFIG_LOG_DEFAULT_LEVEL_INFO=y
CONFIG_FREERTOS_HZ=1000
# Console output via built-in USB-Serial-JTAG (appears as /dev/ttyACM* on Linux).
# This is the hardware USB-Serial-JTAG peripheral — NOT TinyUSB CDC (which
# stalls when no host is connected). Lets us flash + monitor through the
# single native USB port on bare ESP32-S3 modules.
CONFIG_ESP_CONSOLE_USB_SERIAL_JTAG=y
CONFIG_ESP_CONSOLE_USB_CDC=n
CONFIG_ESP_CONSOLE_UART_DEFAULT=n

# Security hardening (audit S-01) — explicit brownout protection
# Rationale: 80 MHz SPI + Octal PSRAM + Wi-Fi (Sprint 2) creates rail sag;
# do not rely on IDF implicit default across upgrades.
CONFIG_ESP_BROWNOUT_DET=y
CONFIG_ESP_BROWNOUT_DET_LVL_SEL_7=y

# Security hardening (audit S-02) — compiler defense-in-depth
# Stack canaries detect smash before return; mandatory before ESP-NOW
# header parsing (Sprint 2) dereferences attacker-supplied length fields.
CONFIG_COMPILER_STACK_CHECK=y
CONFIG_COMPILER_STACK_CHECK_MODE_NORM=y
CONFIG_COMPILER_WARN_WRITE_STRINGS=y

# Smoke-test mode: display-only demo loop (color bars / gradient / checker /
# tearing stripes). Skips ESP-NOW / decode / link UI so the LCD can be
# validated standalone before a transmitter is wired up. Disable
# (CONFIG_RECEIVER_SMOKE_TEST=n) for the real video pipeline.
CONFIG_RECEIVER_SMOKE_TEST=n

# Bypass BLE pair handshake using the TX MAC the user already captured
# from the TX boot log. This is the Kconfig override path documented in
# spec §11.5 — useful when BLE is failing or unavailable but the TX is
# already running and broadcasting on Wi-Fi channel 6.
CONFIG_RECEIVER_PEER_MAC="98:A3:16:F5:2C:94"

# Sprint 4 — BLE pairing via NimBLE was enabled here, but on this hw
# combo (ESP32-S3-N16R8 + Octal PSRAM @ 80 MHz + IDF 6.0.1) merely
# turning on CONFIG_BT_ENABLED freezes the chip at "cpu_start: Multicore
# app" before main_task spawns — no panic, no logs, no progression.
# Until that is root-caused (likely an IDF init-order or PSRAM heap
# layout conflict), keep BT off and rely on CONFIG_RECEIVER_PEER_MAC
# above to skip the BLE handshake. ble_pair.cpp is gated with
# #if CONFIG_BT_NIMBLE_ENABLED so the build still works.
#CONFIG_BT_ENABLED=y
#CONFIG_BT_NIMBLE_ENABLED=y
#CONFIG_BT_CONTROLLER_ENABLED=y
#CONFIG_BT_CONTROLLER_MODE_BLE_ONLY=y

# USB-Serial-JTAG: don't block the caller if the USB endpoint isn't ready
# yet (the firmware stays responsive while a host attaches).
CONFIG_ESP_CONSOLE_USB_SERIAL_JTAG_LOG_NO_BLOCK=y
```
